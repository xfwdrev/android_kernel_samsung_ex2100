## drivers/battery/charger/pca9468_charger/Kconfig
```kconfig
if UML

config BATTERY_SAMSUNG
	tristate "samsung battery driver"
	help
	  Say Y to include support for samsung battery driver
	  This battery driver integrated all battery-related functions
	  To see battery-related functions,
	  refer to sec_charging_common.h

config SEC_PD
	tristate "support for sec pd"
	help
	 Say Y to include support for sec pd control module.
	 This sec_pd driver integrated all pdo related function.
	 To see pdo related functions,
	 refer to sec_pd.h

config REGMAP
	default y
	bool

endif

config CHARGER_PCA9468
	tristate "PCA9468 charger driver"
	default n
	depends on DIRECT_CHARGING
	help
	  Say Y or M here,
	  to enable support for the PCA9468 charger.
	  This is 2:1 switched capacitor direct charger.
	  To compile the driver as a module, choose M here.

config SEND_PDMSG_IN_PPS_REQUEST_WORK
	bool "PCA9468 send pdmsg in request work"
	default n
	help
	  Say Y here to enable
	  support for send pdmsg in direct charger.
	  This options for pdic not support periodic send pdmsg.
	  If this is Y in direct charger, direct charger send pdmsg periodic.
```

## drivers/input/sec_input/slsi/Kconfig
```kconfig
# SPDX-License-Identifier: GPL-2.0-only
#
# SLSI TOUCH driver configuration
#

config TOUCHSCREEN_SLSI
	tristate "SLSI Touchscreen"
	depends on I2C
    help
      Say Y here if you want support for SEC touchscreen controllers.
      If unsure, say N.

config TOUCHSCREEN_SLSI_CMD_TEST
	tristate "KUnit test for SLSI Touchscreen cmd test"
	depends on SEC_KUNIT
	help
	  TODO: Describe config fully.
```

## drivers/input/sec_input/synaptics/Kconfig
```kconfig
# SPDX-License-Identifier: GPL-2.0-only
#
# SYNAPTICS TOUCH driver configuration
#

config TOUCHSCREEN_SYNAPTICS_SPI
    tristate "SYNAPTICS SPI Touchscreen"
    depends on SPI
    help
      Say Y here if you want support for SYNAPTICS SPI touchscreen controllers.
      If unsure, say N.

config TOUCHSCREEN_SYNAPTICS_I2C
    tristate "SYNAPTICS I2C Touchscreen"
    depends on I2C
    help
      Say Y here if you want support for SYNAPTICS I2C touchscreen controllers.
      If unsure, say N.
```

## drivers/input/sec_input/wacom/Kconfig
```kconfig
#
# Wacom configuration
#

config EPEN_WACOM_WEZ01
	tristate "Wacom penabled i2c touchscreen"
	depends on I2C
	help
	  Say Y here if you have an Wacom penabled i2c touchscreen
	  connected to your system.

	  If unsure, say N.

	  To compile this driver as a module, choose M here: the
	  module will be called wacom.

config EPEN_WACOM_W9020
	bool "Wacom W9020 penabled i2c touchscreen"
	depends on EPEN_WACOM_WEZ01
	help
	  Say Y here if you are using the W9020 digitizer instead of WEZ01.
```

## drivers/input/wacom/Kconfig
```kconfig
#
# Wacom configuration
#

config INPUT_WACOM
	tristate "Wacom penabled i2c touchscreen"
	depends on I2C
	help
	  Say Y here if you have an Wacom penabled i2c touchscreen
	  connected to your system.
	  If unsure, say N.

config EPEN_WACOM_W9020
	tristate "Wacom W9020 penabled i2c touchscreen"
	depends on I2C
	help
	  Say Y here if you have an Wacom G10PM penabled i2c touchscreen
	  connected to your system.
	  If unsure, say N.

config EPEN_WACOM_W9021
	tristate "Wacom W9021 penabled i2c touchscreen"
	depends on I2C
	help
	  Say Y here if you have an Wacom G10PM penabled i2c touchscreen
	  connected to your system.
	  If unsure, say N.

config EPEN_WACOM_WEZ01
	tristate "Wacom WEZ01 penabled i2c touchscreen"
	depends on I2C
	help
	  Say Y here if you have an Wacom penabled i2c touchscreen
	  connected to your system.
	  If unsure, say N.
```

## drivers/knox/ngksm/Kconfig
```kconfig
# @file Kconfig
# @brief Kconfig for Next Generation Knox Security Driver
# Copyright (c) 2019, Samsung Electronics Corporation. All rights reserved.
#
# This program is free software; you can redistribute it and/or modify
# it under the terms of the GNU General Public License version 2 and
# only version 2 as published by the Free Software Foundation.
#
# This program is distributed in the hope that it will be useful,
# but WITHOUT ANY WARRANTY; without even the implied warranty of
# MERCHANTABILITY or FITNESS FOR A PARTICULAR PURPOSE.  See the
# GNU General Public License for more details.

config NGKSM
	bool "Next Generation Knox Security Monitor feature enable"
	depends on !SEC_FACTORY
	depends on !ARCH_QTI_VM
	default y
	help
	This enables knox securty monitor driver

config NGKPAD
	bool "Next Generation Knox Peripheral Access Detection feature enable"
	depends on UH
	depends on NGKSM
	default y
	help
	This enables Next Generation Knox Peripheral Access Detection
```

## drivers/regulator/s2dos05/Kconfig
```kconfig
if REGULATOR

config REGULATOR_S2DOS05
	tristate "Samsung S2DOS05 regulator"
	depends on I2C
	help
	 This driver controls a Samsung S2DOS05 regulator
	 via I2C bus.

config REGULATOR_S2DOS05_ELVSS_FD
	bool "Samsung S2DOS05 ELVSS FD"
	help
	 If ELVSS is enabled, FD is on.

endif
```

## drivers/sensors/vl53l5/Kconfig
```kconfig
# SPDX-License-Identifier: GPL-2.0-only


config SENSORS_VL53L5
	depends on SPI
	tristate "VL53L5 driver"
	default n
	help
	  Say Y here if you use VL53L5.
	  This option enables range sensor using VL53L5.

config SENSORS_VL53L5_SUPPORT_UAPI
	tristate "STM vl53l5 ranging sensor UPAI interface"
	default n
	help
	  STM vl53l5 ranging sensor UPAI interface.

config SENSORS_VL53L5_SUPPORT_KERNEL_INTERFACE
	tristate "STM vl53l5 ranging sensor Kernel Interface"
	default n
	help
	  STM vl53l5 ranging sensor Kernel Interface.

config SENSORS_VL53L5_QCOM
	tristate "vl53l5 ranging sensor feature for Snapdragon"
	default n
	help
	  vl53l5 ranging sensor feature for Snapdragon AP.

config SENSORS_VL53L5_SLSI
	tristate "vl53l5 ranging sensor feature for Exynos"
	default n
	help
	  vl53l5 ranging sensor feature for Exynos AP.
```

## drivers/uwb/Kconfig
```kconfig
#
# UWB device configuration
#
config SAMSUNG_UWB
	tristate "Samsung UWB driver"
	default n
	help
	  Say Y here if you want to build support for UWB devices.
	  To compile this support as a module, choose M here: the module will
	  be called uwb.

config UWB_SR100
	bool "Nxp SPI driver for SR100 devices"
	default n
	help
	  NXP SR100 UWB controller support.

config SEC_UWB_LOGGER
	bool "UWB logger"
	default n
	help
	  Enable UWB logger.

config ACPM_INIT
	bool "ACPM INIT"
	default n
	help
	  ACPM INIT must be called to use CLK4 in S5910.

config UWB_QM35
	bool "Qorvo SPI driver for QM35 devices"
	default n
	help
	  Qorvo QM35 UWB controller support.
```

## drivers/vibrator/cs40l2x/Kconfig
```kconfig
config MOTOR_CS40L2X
	tristate "Cirrus CS40L2X motor"
	depends on I2C
	default n
	help
	  Say Y to enable MOTOR_CS40L2X
	  You can get support for vibration with
	  cs40l2x driver ic if you enable
	  this config.

config CS40L2X_SAMSUNG_FEATURE
	bool "Cirrus CS40L2X motor and Samsung feature"
	depends on MOTOR_CS40L2X
	default n
	help
	  Say Y to enable CS40L2X_SAMSUNG_FEATURE
	  codes featured with this comment
	  aren't the original code from cirrus.
	  To use samsung concept, please enable this.

config SUPPORT_OWT_CWS
	bool "OWT CWS support"
	default n
	help
	  If you say yes here you will get support for
	  OWT(open wave table) and CWS(Chirp with scalability).
	  Enabling this feature will create ops functions
	  which is required for OWT CWS support

config CS40L2X_VIB_FOLD_MODEL
	bool "get support for folder status "
	default n
	help
	  If you enable this feature,
	  you will get event for folder status
	  through event_cmd sysfs
```
